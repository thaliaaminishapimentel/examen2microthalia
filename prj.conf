## CMakeLists.txt
```
# FRDM-MCXA156 | integrated ADC/GPIO/TIMER/UART application
# Uses the official NXP MCUXpresso SDK build system and Arm GNU toolchain.
cmake_minimum_required(VERSION 3.22.0)

# Explicit board selection for standalone SDK project (FRDM-MCXA156).
set(board frdmmcxa156)
set(board_root examples/_boards)

include(${SdkRootDirPath}/cmake/extension/mcux.cmake)
project(analog_alarm LANGUAGES C CXX ASM
    PROJECT_BOARD_PORT_PATH ${board_root}/${board}/driver_examples/lpadc/polling)
include(${SdkRootDirPath}/CMakeLists.txt)

mcux_add_source(
    SOURCES
        src/lpadc_polling.c
        src/hardware_init.c
        src/pin_mux.c
        src/app.h
        src/pin_mux.h
        src/alarm_core.h
)
mcux_add_include(INCLUDES src)
mcux_convert_binary(BINARY ${APPLICATION_BINARY_DIR}/${MCUX_SDK_PROJECT_NAME}.bin)
```

## prj.conf
```kconfig
# Supplemental SDK drivers for the imported NXP lpadc_polling example.
CONFIG_MCUX_COMPONENT_driver.lpadc=y
CONFIG_MCUX_COMPONENT_driver.ctimer=y
CONFIG_MCUX_COMPONENT_driver.gpio=y
CONFIG_MCUX_COMPONENT_driver.port=y
CONFIG_MCUX_COMPONENT_driver.lpuart=y
CONFIG_MCUX_COMPONENT_driver.reset=y
CONFIG_MCUX_COMPONENT_driver.inputmux=y
# Project supplies its own hardware_init and pin_mux to avoid duplicate symbols.
CONFIG_MCUX_HAS_PRJSEG_project.use_hw_app=n
CONFIG_MCUX_PRJSEG_module.board.pinmux_project_folder=n
CONFIG_MCUX_PRJSEG_module.board.pinmux_board_folder=n
CONFIG_MCUX_HAS_PRJSEG_module.board.pinmux_sel=n
```

## src/alarm_core.h
```c
/* SPDX-License-Identifier: MIT */
#ifndef ALARM_CORE_H
#define ALARM_CORE_H

#include <stdbool.h>
#include <stdint.h>
#include <stddef.h>
#include <string.h>

/* Pure logic: can be tested without the FRDM board. */
typedef struct
{
    uint8_t threshold;
    uint8_t percent;
    uint16_t adc;
    bool has_sample;
    bool running;
    bool alarm;
    bool reset_decision;
} alarm_core_t;

static inline uint8_t alarm_pct16(uint16_t adc)
{
    /* Rounded 100 * ADC / 65535 with a 32-bit intermediate. */
    return (uint8_t)(((uint32_t)adc * 100U + 32767U) / 65535U);
}

static inline void alarm_init(alarm_core_t *c)
{
    c->threshold = 70U;
    c->percent = 0U;
    c->adc = 0U;
    c->has_sample = false;
    c->running = true;
    c->alarm = false;
    c->reset_decision = true;
}

static inline void alarm_restart_decision(alarm_core_t *c)
{
    if (!c->running)
    {
        c->alarm = false;
        return;
    }
    if (c->has_sample)
    {
        c->alarm = (c->percent >= c->threshold);
        c->reset_decision = false;
    }
    else
    {
        c->alarm = false;
        c->reset_decision = true;
    }
}

static inline void alarm_start(alarm_core_t *c)
{
    if (!c->running)
    {
        c->running = true;
        alarm_restart_decision(c);
    }
}

static inline void alarm_stop(alarm_core_t *c)
{
    c->running = false;
    c->alarm = false;
}

static inline void alarm_toggle(alarm_core_t *c)
{
    if (c->running) alarm_stop(c);
    else alarm_start(c);
}

static inline void alarm_set_thr(alarm_core_t *c, uint8_t thr)
{
    c->threshold = thr;
    alarm_restart_decision(c);
}

static inline void alarm_sample(alarm_core_t *c, uint16_t adc)
{
    c->adc = adc;
    c->percent = alarm_pct16(adc);
    c->has_sample = true;
    if (!c->running)
    {
        c->alarm = false;
    }
    else if (c->reset_decision)
    {
        alarm_restart_decision(c);
    }
    else if (c->percent >= c->threshold)
    {
        c->alarm = true;
    }
    else if (c->percent < (uint8_t)(c->threshold - 5U))
    {
        c->alarm = false;
    }
    /* Hold state inside the five percentage-point hysteresis band. */
}

/* Only EXACT uppercase commands; THR n: decimal 10..95, no trailing chars. */
typedef enum { ALARM_CMD_IGNORE, ALARM_CMD_STATUS, ALARM_CMD_THR,
               ALARM_CMD_START, ALARM_CMD_STOP, ALARM_CMD_ERR } alarm_cmd_t;
static inline alarm_cmd_t alarm_parse(const char *line, uint8_t *new_thr)
{
    unsigned value = 0;
    size_t i;
    if (line[0] == '\0') return ALARM_CMD_IGNORE;
    if (strcmp(line, "STATUS") == 0) return ALARM_CMD_STATUS;
    if (strcmp(line, "START") == 0) return ALARM_CMD_START;
    if (strcmp(line, "STOP") == 0) return ALARM_CMD_STOP;
    if (strncmp(line, "THR ", 4) != 0) return ALARM_CMD_ERR;
    if (line[4] == '\0') return ALARM_CMD_ERR;
    for (i = 4; line[i] != '\0'; ++i)
    {
        if (line[i] < '0' || line[i] > '9') return ALARM_CMD_ERR;
        value = value * 10U + (unsigned)(line[i] - '0');
        if (value > 95U) return ALARM_CMD_ERR;
    }
    if (value < 10U) return ALARM_CMD_ERR;
    *new_thr = (uint8_t)value;
    return ALARM_CMD_THR;
}

typedef struct
{
    bool raw;
    bool stable;
    uint32_t changed_at;
} alarm_debounce_t;

static inline void alarm_debounce_init(alarm_debounce_t *d, bool initial_raw)
{
    d->raw = initial_raw;
    d->stable = initial_raw;
    d->changed_at = 0;
}

/* Returns true ONCE per debounced press. Release must stabilize first. */
static inline bool alarm_debounce_pressed(alarm_debounce_t *d, bool pressed, uint32_t now)
{
    if (pressed != d->raw)
    {
        d->raw = pressed;
        d->changed_at = now;
    }
    if ((d->raw != d->stable) && ((uint32_t)(now - d->changed_at) >= 30U))
    {
        d->stable = d->raw;
        return d->stable;
    }
    return false;
}

#endif /* ALARM_CORE_H */
```

## src/app.h
```c
/* SPDX-License-Identifier: MIT */
#ifndef APP_H_
#define APP_H_
void BOARD_InitHardware(void);
#endif
```

## src/hardware_init.c
```c
/* SPDX-License-Identifier: MIT */
/* Based on NXP's FRDM-MCXA156 lpadc_polling BOARD_InitHardware setup. */
#include "pin_mux.h"
#include "board.h"
#include "clock_config.h"
#include "fsl_clock.h"
#include "fsl_reset.h"

void BOARD_InitHardware(void)
{
    /* ADC1 functional clock = FRO12M/1 (12 MHz). */
    RESET_ReleasePeripheralReset(kADC1_RST_SHIFT_RSTn);
    CLOCK_AttachClk(kFRO12M_to_ADC1);
    CLOCK_SetClockDiv(kCLOCK_DivADC1, 1U);
    BOARD_InitPins();
    BOARD_InitBootClocks();
    BOARD_InitDebugConsole(); /* initializes board VCOM clock */
}
```

## src/pin_mux.c
```c
/* SPDX-License-Identifier: MIT */
/* Manual configuration for FRDM-MCXA156 (from NXP SDK pin examples). */
#include "fsl_common.h"
#include "fsl_clock.h"
#include "fsl_reset.h"
#include "fsl_port.h"
#include "fsl_gpio.h"
#include "pin_mux.h"

void BOARD_InitBootPins(void) { BOARD_InitPins(); }

void BOARD_InitPins(void)
{
    /* Only the gates of used GPIO/PORT banks and UART/ADC are touched. */
    CLOCK_EnableClock(kCLOCK_GateGPIO1);
    CLOCK_EnableClock(kCLOCK_GateGPIO3);
    CLOCK_EnableClock(kCLOCK_GatePORT0);
    CLOCK_EnableClock(kCLOCK_GatePORT1);
    CLOCK_EnableClock(kCLOCK_GatePORT3);
    RESET_ReleasePeripheralReset(kGPIO1_RST_SHIFT_RSTn);
    RESET_ReleasePeripheralReset(kGPIO3_RST_SHIFT_RSTn);
    RESET_ReleasePeripheralReset(kLPUART0_RST_SHIFT_RSTn);
    RESET_ReleasePeripheralReset(kADC1_RST_SHIFT_RSTn);
    RESET_ReleasePeripheralReset(kPORT0_RST_SHIFT_RSTn);
    RESET_ReleasePeripheralReset(kPORT1_RST_SHIFT_RSTn);
    RESET_ReleasePeripheralReset(kPORT3_RST_SHIFT_RSTn);

    const port_pin_config_t uart_pin = {
        kPORT_PullUp, kPORT_LowPullResistor, kPORT_FastSlewRate,
        kPORT_PassiveFilterDisable, kPORT_OpenDrainDisable,
        kPORT_LowDriveStrength, kPORT_NormalDriveStrength,
        kPORT_MuxAlt2, kPORT_InputBufferEnable, kPORT_InputNormal,
        kPORT_UnlockRegister
    };
    const port_pin_config_t analog_pin = {
        kPORT_PullDisable, kPORT_LowPullResistor, kPORT_FastSlewRate,
        kPORT_PassiveFilterDisable, kPORT_OpenDrainDisable,
        kPORT_LowDriveStrength, kPORT_NormalDriveStrength,
        kPORT_MuxAlt0, kPORT_InputBufferDisable, kPORT_InputNormal,
        kPORT_UnlockRegister
    };
    const port_pin_config_t gpio_out = {
        kPORT_PullDisable, kPORT_LowPullResistor, kPORT_FastSlewRate,
        kPORT_PassiveFilterDisable, kPORT_OpenDrainDisable,
        kPORT_LowDriveStrength, kPORT_NormalDriveStrength,
        kPORT_MuxAlt0, kPORT_InputBufferEnable, kPORT_InputNormal,
        kPORT_UnlockRegister
    };
    const port_pin_config_t gpio_in = {
        kPORT_PullUp, kPORT_LowPullResistor, kPORT_FastSlewRate,
        kPORT_PassiveFilterDisable, kPORT_OpenDrainDisable,
        kPORT_LowDriveStrength, kPORT_NormalDriveStrength,
        kPORT_MuxAlt0, kPORT_InputBufferEnable, kPORT_InputNormal,
        kPORT_UnlockRegister
    };
    const gpio_pin_config_t led = { .pinDirection=kGPIO_DigitalOutput, .outputLogic=0U };
    const gpio_pin_config_t sw = { .pinDirection=kGPIO_DigitalInput, .outputLogic=0U };

    PORT_SetPinConfig(PORT0, 2U, &uart_pin);   /* MCU-Link RX */
    PORT_SetPinConfig(PORT0, 3U, &uart_pin);   /* MCU-Link TX */
    PORT_SetPinConfig(PORT1, 10U, &analog_pin); /* A0 = ADC1_A8 */
    PORT_SetPinConfig(PORT1, 7U, &gpio_in);   /* SW2 = active low */
    PORT_SetPinConfig(PORT3, 1U, &gpio_out);  /* D2 activity */
    PORT_SetPinConfig(PORT3, 31U, &gpio_out); /* D4 alarm */
    GPIO_PinInit(GPIO1, 7U, &sw);
    GPIO_PinInit(GPIO3, 1U, &led);
    GPIO_PinInit(GPIO3, 31U, &led);
}
```

## src/pin_mux.h
```c
/* SPDX-License-Identifier: MIT */
#ifndef PIN_MUX_H_
#define PIN_MUX_H_
#ifdef __cplusplus
extern "C" {
#endif
void BOARD_InitBootPins(void);
void BOARD_InitPins(void);
#ifdef __cplusplus
}
#endif
#endif
```
